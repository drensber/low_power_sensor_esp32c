## CMakeLists.txt
```
# Copyright (c) 2025 Espressif Systems (Shanghai) Co., Ltd.
# SPDX-License-Identifier: Apache-2.0

cmake_minimum_required(VERSION 3.20.0)

list(APPEND EXTRA_CONF_FILE "${CMAKE_CURRENT_SOURCE_DIR}/../lp_hp_shared.conf")

find_package(Zephyr REQUIRED HINTS $ENV{ZEPHYR_BASE})

message(STATUS "${BOARD} compiles as lpcore_image in this build")
project(low_power_sensor_lpcore)

zephyr_include_directories(include ../include)

target_sources(app PRIVATE src/main.c src/aht20.c)
```

## Kconfig
```
source "Kconfig.zephyr"
rsource "../Kconfig.lp_hp_shared"
```

## prj.conf
```kconfig
# Enable Zephyr Logging
CONFIG_LOG=y

# 0-4  4 is DEBUG
CONFIG_LPS_LOG_LEVEL=0


# nothing here
CONFIG_MBOX=y

# Minimal logging mode might be required for the LP core to stay under 8KB
CONFIG_LOG_MODE_MINIMAL=y
```

## app.overlay
```dts
/*
 * Copyright (c) 2025 Espressif Systems (Shanghai) Co., Ltd.
 *
 * SPDX-License-Identifier: Apache-2.0
 */

/ {
	chosen {
		zephyr,ipc_shm = &ipc_shm;
		zephyr,ipc = &mbox0;
	};

        mbox_consumer {
               compatible = "vnd,mbox-consumer";
               mboxes = <&mbox0 0>, <&mbox0 1>;
	       mbox-names = "rx", "tx";
        };
};

// Change this from the default to "disabled" for production because it consumes about 100uA
/*
&lp_uart {
	status = "disabled";
};
*/

/* Leaving this here for when Zephyr support for LP i2c is added

&lp_i2c0 {
    status = "okay";
    pinctrl-0 = <&lp_i2c0_default>;
    pinctrl-names = "default";
    clock-frequency = <I2C_BITRATE_STANDARD>;
};

&pinctrl {
    lp_i2c0_default: lp_i2c0_default {
        group1 {
            pinmux = <LP_I2C0_SCL_LP_GPIO6>,
                     <LP_I2C0_SDA_LP_GPIO7>;
        }
    };    
};

*/
```

## src/main.c
```c
/*
 * main() routine for the low power core image.
 * 
 * Copyright (c) 2026 Dave Rensberger
 *
 * SPDX-License-Identifier: Apache-2.0
 */

#include <stdint.h>
#include <stdio.h>
#include <stdlib.h>
#include <zephyr/kernel.h>
#include <zephyr/drivers/mbox.h>
#include <zephyr/logging/log.h>
#include "ulp_lp_core.h"
#include "ulp_lp_core_utils.h"
#include "ulp_lp_core_memory_shared.h"
#include "ulp_lp_core_lp_timer_shared.h"
#include "esp_attr.h"

#include "shared_data.h"

LOG_MODULE_REGISTER(lps_lp, CONFIG_LPS_LOG_LEVEL);

extern void read_aht20(lp_to_hp_shared_data_t *);

static struct mbox_msg msg = {0};
static RTC_DATA_ATTR lp_to_hp_shared_data_t mbox_message = {0};

static RTC_DATA_ATTR int16_t most_recent_published_temp = -100;
static RTC_DATA_ATTR uint16_t most_recent_published_hum;
static RTC_DATA_ATTR uint16_t wakeups_since_last_publish;

static RTC_DATA_ATTR volatile publish_status_t hp_publish_status = PUBLISH_STATUS_PENDING; 
static RTC_DATA_ATTR bool waiting_for_ack = false;

const struct mbox_dt_spec tx_channel = MBOX_DT_SPEC_GET(DT_PATH(mbox_consumer), tx);
const struct mbox_dt_spec rx_channel = MBOX_DT_SPEC_GET(DT_PATH(mbox_consumer), rx);

static void mbox_callback(const struct device *dev,
	        	     mbox_channel_id_t channel_id, 
                             void *user_data, struct mbox_msg *data) 
{
    LOG_DBG("LP core mbox_callback called");
 
}

int main(void)
{
    ulp_lp_core_memory_shared_cfg_t *cfg
	= ulp_lp_core_memory_shared_cfg_get();

    int max_transfer_size_bytes = mbox_mtu_get_dt(&tx_channel);
    int mbox_message_size = sizeof(mbox_message);

    mbox_register_callback_dt(&rx_channel, mbox_callback, NULL);
    mbox_set_enabled_dt(&rx_channel, 1);
    
    if (mbox_message_size > max_transfer_size_bytes) {
	LOG_DBG("Size of mbox_message is %d bytes (max is %d)",
	       mbox_message_size, max_transfer_size_bytes);
    }
    
    LOG_DBG("LP core loop %d", mbox_message.lp_wake_count);

    mbox_message.lp_wake_count++;

    read_aht20(&mbox_message);    

    LOG_DBG("hp_publish_status is %d", hp_publish_status);
    
    if (waiting_for_ack) {
        if (hp_publish_status == PUBLISH_STATUS_SUCCESS) {
            LOG_DBG("Previous publish SUCCEEDED.");
            waiting_for_ack = false;
            
            // Safe to reset thresholds now!
            wakeups_since_last_publish = 0;
            most_recent_published_hum = mbox_message.rh_x10;
            most_recent_published_temp = mbox_message.temp_c_x10;
            
        } else if (hp_publish_status == PUBLISH_STATUS_FAILURE) {
            LOG_DBG("Previous publish FAILED. Thresholds intact. Retrying.");
            waiting_for_ack = false;
            
        } else {
            // Still 0. The HP core must be taking a very long time to connect, 
            // or it crashed. We will wait one more cycle.
            LOG_DBG("Publish still pending...");
        }
    }    

    bool time_threshold_exceeded=true;
    bool temperature_threshold_exceeded=true;
    bool humidity_threshold_exceeded=true; 

#if defined(CONFIG_LPS_MAXIMUM_TIME_BETWEEN_PUBLISH_SECONDS) \
    && CONFIG_LPS_MAXIMUM_TIME_BETWEEN_PUBLISH_SECONDS != 0
    uint32_t seconds_since_last_publish =
	(wakeups_since_last_publish * (cfg->sleep_duration_us/1000000));
    LOG_DBG("seconds_since_last_publish = %d", seconds_since_last_publish);
    
    if (seconds_since_last_publish < CONFIG_LPS_MAXIMUM_TIME_BETWEEN_PUBLISH_SECONDS) {
	time_threshold_exceeded=false;
    }
#endif 

#if defined(CONFIG_LPS_TEMP_CHANGE_PUBLISH_THRESHOLD) \
    && CONFIG_LPS_TEMP_CHANGE_PUBLISH_THRESHOLD != 0
    LOG_DBG("temperature change is %d",
	   abs(mbox_message.temp_c_x10 - most_recent_published_temp));
    if (abs(mbox_message.temp_c_x10 - most_recent_published_temp) <
	CONFIG_LPS_TEMP_CHANGE_PUBLISH_THRESHOLD) {
	temperature_threshold_exceeded=false;
    }
#endif    

#if defined(CONFIG_LPS_HUM_CHANGE_PUBLISH_THRESHOLD) \
    && CONFIG_LPS_HUM_CHANGE_PUBLISH_THRESHOLD != 0
    LOG_DBG("humidity change is %d",
	   abs(mbox_message.rh_x10 - most_recent_published_hum));
    if (abs(mbox_message.rh_x10 - most_recent_published_hum) <
	CONFIG_LPS_HUM_CHANGE_PUBLISH_THRESHOLD) {
	humidity_threshold_exceeded=false;
    }
#endif    
    
    if (time_threshold_exceeded ||
	temperature_threshold_exceeded ||
	humidity_threshold_exceeded) {

        if (!waiting_for_ack) {
            LOG_DBG("Threshold met. Waking HP core.");
            
            // Give the HP core the return address for the receipt
            mbox_message.most_recent_publish_status_p = &hp_publish_status;
            hp_publish_status = PUBLISH_STATUS_PENDING; // Reset to pending
            waiting_for_ack = true;

#ifndef CONFIG_LPS_HPCORE_ALWAYS_STAY_AWAKE	    
	    ulp_lp_core_wakeup_main_processor();
#endif	    
	    mbox_message.hp_wake_count++;

	
	    msg.data = &mbox_message;
	    msg.size = mbox_message_size;
	
            // Collapsed into a single string macro
	    LOG_DBG("Calling mbox_send with:\n" \
                    "  .lp_wake_count=%d\n" \
		    "  .hp_wake_count=%d\n" \
		    "  .temp_c_x10=%d .rh_x10=%d\n" \
		    "  .most_recent_publish_status_p=0x%x",		\
		   ((lp_to_hp_shared_data_t *) msg.data)->lp_wake_count, \
		   ((lp_to_hp_shared_data_t *) msg.data)->hp_wake_count, \
		   ((lp_to_hp_shared_data_t *) msg.data)->temp_c_x10, \
		   ((lp_to_hp_shared_data_t *) msg.data)->rh_x10, \
		   (uint32_t)((lp_to_hp_shared_data_t *) msg.data)->most_recent_publish_status_p);

	    LOG_DBG("  *(most_recent_publish_status_p) = %d", \
		    (uint32_t)*(((lp_to_hp_shared_data_t *) msg.data)->most_recent_publish_status_p));
		
	    mbox_message.shared_magic = SHARED_DATA_MAGIC_NUMBER;
	    if (mbox_send_dt(&tx_channel, &msg) < 0) {
		LOG_ERR("mbox_send() error");
	    }
	
	    k_msleep(100);
	} else {
            LOG_DBG("Skipping HP wake. Actively waiting for network receipt.");
            wakeups_since_last_publish++;
        }	
    }
    else {
	wakeups_since_last_publish++;
    }

    

    LOG_DBG("LP core Going to sleep");
        
    if (cfg->sleep_duration_ticks) {
	ulp_lp_core_lp_timer_set_wakeup_ticks
	    (cfg->sleep_duration_ticks);
    }
	
    //Busy wait to let the printf UART finish
    ulp_lp_core_delay_us(500);
    
    ulp_lp_core_halt();

    return 0;
}
```

## src/aht20.c
```c
#define AHT20_I2C_ADDR 0x38
#include <zephyr/kernel.h>
#include <zephyr/logging/log.h>
#include "shared_data.h"

LOG_MODULE_DECLARE(lps_lp, CONFIG_LPS_LOG_LEVEL);

#if 1
// The lp_i2c API isn't supported yet for the esp32c6.
// This is a workaround implementation that uses the esp-idf to do software bitbanging instead.

#include "ulp_lp_core_gpio.h" // Drop to the lowest level GPIO macros

#define SCL_PIN 0
#define SDA_PIN 1
#define AHT20_ADDR AHT20_I2C_ADDR

// --- 1. Raw GPIO Open-Drain Primitives ---
static void i2c_delay(void) {
    // A crude but effective microsecond delay.
    // LP core runs at roughly 16-20MHz. This safely gives us ~5us for 100kHz I2C.
    for (volatile int i = 0; i < 25; i++); 
}

static void sda_high(void) { ulp_lp_core_gpio_output_disable(SDA_PIN); }
static void sda_low(void)  { ulp_lp_core_gpio_output_enable(SDA_PIN); ulp_lp_core_gpio_set_level(SDA_PIN, 0); }
static void scl_high(void) { ulp_lp_core_gpio_output_disable(SCL_PIN); }
static void scl_low(void)  { ulp_lp_core_gpio_output_enable(SCL_PIN); ulp_lp_core_gpio_set_level(SCL_PIN, 0); }

// --- 2. I2C Protocol Logic ---
static void i2c_start(void) {
    sda_high(); scl_high(); i2c_delay();
    sda_low();  i2c_delay();
    scl_low();  i2c_delay();
}

static void i2c_stop(void) {
    sda_low();  scl_low();  i2c_delay();
    scl_high(); i2c_delay();
    sda_high(); i2c_delay();
}

static void i2c_write_bit(int bit) {
    if (bit) sda_high(); else sda_low();
    i2c_delay();
    scl_high(); i2c_delay();
    scl_low();  i2c_delay();
}

static int i2c_read_bit(void) {
    sda_high(); i2c_delay(); // Release SDA to read
    scl_high(); i2c_delay();
    int bit = ulp_lp_core_gpio_get_level(SDA_PIN);
    scl_low();  i2c_delay();
    return bit;
}

static int i2c_write_byte(uint8_t data) {
    for (int i = 0; i < 8; i++) {
        i2c_write_bit((data & 0x80) != 0);
        data <<= 1;
    }
    return i2c_read_bit(); // Returns the ACK bit (0 = ACK, 1 = NACK)
}

static uint8_t i2c_read_byte(int ack) {
    uint8_t data = 0;
    for (int i = 0; i < 8; i++) {
        data = (data << 1) | i2c_read_bit();
    }
    i2c_write_bit(ack); // 0 = ACK, 1 = NACK
    return data;
}

// --- 3. The AHT20 Sensor Routine ---
void read_aht20(lp_to_hp_shared_data_t *return_data) {
    // Init pins as inputs (pulled high by external resistors)
    ulp_lp_core_gpio_init(SCL_PIN);
    ulp_lp_core_gpio_init(SDA_PIN);

    // 2. THE MISSING LINK: Enable the input buffers so we can actually read the line!
    ulp_lp_core_gpio_input_enable(SCL_PIN);
    ulp_lp_core_gpio_input_enable(SDA_PIN);
    
    // 3. Enable internal pull-ups (belt and suspenders)
    ulp_lp_core_gpio_pullup_enable(SCL_PIN);
    ulp_lp_core_gpio_pullup_enable(SDA_PIN);    

    
    // Trigger Measurement
    i2c_start();
    if (i2c_write_byte(AHT20_ADDR << 1) != 0) {
	LOG_DBG("i2c write error 1");
	return; // Write Addr (NACKed)
    }
    i2c_write_byte(0xAC);
    i2c_write_byte(0x33);
    i2c_write_byte(0x00);
    i2c_stop();

    k_msleep(80); // We can still use Zephyr's low-res sleep here

    // Read Data
    i2c_start();
    if (i2c_write_byte((AHT20_ADDR << 1) | 1) != 0) {
	LOG_DBG("i2c write error 2");
	return; // Read Addr
    }
    
    uint8_t data[6];
    for (int i = 0; i < 6; i++) {
        // Send ACK (0) for first 5 bytes, NACK (1) for the last byte
        data[i] = i2c_read_byte((i == 5) ? 1 : 0); 
    }
    i2c_stop();

    if ((data[0] & 0x80) != 0) {
	LOG_DBG("i2c sensor busy");
	return; // Sensor busy
    }
    
    uint32_t raw_temp = ((data[3] & 0x0F) << 16) | (data[4] << 8) | data[5];

    //return (int32_t)((raw_temp * 625) >> 15) - 5000;
    return_data->temp_c_x10 = ((raw_temp * 250) >> 17) - 500;

    uint32_t raw_humidity = ((data[1] << 12) | (data[2] << 4) | (data[3] >> 4));
    return_data->rh_x10 = (raw_humidity * 125) >> 17;
    
}
#else // 1
// This is the the Zephyr lp_i2c hardware i2c API implementation. Switch once supported
#include <zephyr/drivers/i2c.h>

// Get the I2C bus pointer from the Devicetree
const struct device *i2c_dev = DEVICE_DT_GET(DT_NODELABEL(lp_i2c0));

int32_t read_aht20_temp(void) {
    if (!device_is_ready(i2c_dev)) {
        return 0; // Bus not ready
    }

    // 1. Trigger Measurement Command
    uint8_t cmd[3] = {0xAC, 0x33, 0x00};
    if (i2c_write(i2c_dev, cmd, 3, AHT20_I2C_ADDR) != 0) {
        return 0; // Write failed
    }

    // 2. Wait for the sensor to process (Datasheet says 80ms)
    k_msleep(80);

    // 3. Read the 6 bytes of data
    uint8_t data[6] = {0};
    if (i2c_read(i2c_dev, data, 6, AHT20_I2C_ADDR) != 0) {
        return 0; // Read failed
    }

    // Check if the sensor is still busy (Bit 7 of Byte 0)
    if ((data[0] & 0x80) != 0) {
        return 0; // Sensor didn't finish in time
    }

    // 4. Extract Temperature (Bottom half of Byte 3, plus Bytes 4 and 5)
    uint32_t raw_temp = ((data[3] & 0x0F) << 16) | (data[4] << 8) | data[5];

    // 5. Integer Math! (Instead of T = (raw/2^20)*200 - 50, we multiply by 20000 first)
    // This gives us the temperature in Celsius * 100 (e.g., 2250 = 22.50 C)
    int32_t temp_c_x100 = (int32_t)((raw_temp * 20000) >> 20) - 5000;

    return temp_c_x100;
}
#endif
```
